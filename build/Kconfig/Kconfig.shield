## build/Kconfig/boards/Kconfig.defconfig
```kconfig
# Load Zephyr board defconfig descriptions.
osource "C:/Users/udash/nordic/MyApps/zephyr/boards/nordic/nrf52840dongle/Kconfig.defconfig"
```

## build/blinky_1/Kconfig/arch/Kconfig
```kconfig
# Load Zephyr Arch Kconfig descriptions.
osource "C:/Users/udash/nordic/MyApps/zephyr/arch/rx/Kconfig"
osource "C:/Users/udash/nordic/MyApps/zephyr/arch/x86/Kconfig"
osource "C:/Users/udash/nordic/MyApps/zephyr/arch/xtensa/Kconfig"
osource "C:/Users/udash/nordic/MyApps/zephyr/arch/sparc/Kconfig"
osource "C:/Users/udash/nordic/MyApps/zephyr/arch/riscv/Kconfig"
osource "C:/Users/udash/nordic/MyApps/zephyr/arch/posix/Kconfig"
osource "C:/Users/udash/nordic/MyApps/zephyr/arch/mips/Kconfig"
osource "C:/Users/udash/nordic/MyApps/zephyr/arch/arm64/Kconfig"
osource "C:/Users/udash/nordic/MyApps/zephyr/arch/arm/Kconfig"
osource "C:/Users/udash/nordic/MyApps/zephyr/arch/arc/Kconfig"
```

## build/blinky_1/Kconfig/boards/Kconfig
```kconfig
# Load Zephyr board Kconfig descriptions.
osource "C:/Users/udash/nordic/MyApps/zephyr/boards/nordic/nrf52840dongle/Kconfig"
```

## build/blinky_1/Kconfig/boards/Kconfig.nrf52840dongle
```kconfig
# Load board Kconfig descriptions.
osource "C:/Users/udash/nordic/MyApps/zephyr/boards/nordic/nrf52840dongle/Kconfig.nrf52840dongle"
```

## build/blinky_1/Kconfig/boards/Kconfig.sysbuild
```kconfig
# Load Sysbuild board Kconfig descriptions.
osource "C:/Users/udash/nordic/MyApps/zephyr/boards/nordic/nrf52840dongle/Kconfig.sysbuild"
```
